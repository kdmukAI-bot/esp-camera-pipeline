## Kconfig
```kconfig
menu "Camera Pipeline"

    config CAM_PIPELINE_DEBUG
        bool "Enable pipeline performance metrics"
        default n
        help
            Enables per-stage FPS logging (camera, display, consumer)
            with timing breakdowns. Logged at the configured interval.

    config CAM_PIPELINE_DEBUG_LOG_INTERVAL_MS
        int "Debug metrics log interval (ms)"
        default 2000
        depends on CAM_PIPELINE_DEBUG

endmenu
```

## components/cam_pipeline_qr/Kconfig
```kconfig
menu "Camera Pipeline QR Consumer"

    config CAM_PIPELINE_QR_TASK_STACK_SIZE
        int "QR decode task stack size"
        default 32768

    config CAM_PIPELINE_QR_TASK_PRIORITY
        int "QR decode task priority"
        default 5

    config CAM_PIPELINE_QR_DEBUG
        bool "Enable QR consumer performance metrics"
        default n
        help
            Enables QR decode timing metrics (grayscale conversion,
            quirc detection, decode rate). Logged at the configured interval.

    config CAM_PIPELINE_QR_DEBUG_LOG_INTERVAL_MS
        int "QR debug metrics log interval (ms)"
        default 2000
        depends on CAM_PIPELINE_QR_DEBUG

endmenu
```

## components/k_quirc/Kconfig
```kconfig
menu "K-Quirc QR Decoder"

    config K_QUIRC_MAX_VERSION
        int "Maximum QR code version (1-40)"
        default 25
        range 1 40
        help
            Higher versions support larger QR codes but use more memory.
            Version 25 = 117x117 modules. Version 15 = 77x77 modules.
            Most Bitcoin/crypto QR codes fit within version 15.

    config K_QUIRC_ADAPTIVE_THRESHOLD
        bool "Enable adaptive threshold"
        default y

    config K_QUIRC_BILINEAR_THRESHOLD
        bool "Enable bilinear threshold interpolation"
        default y

    config K_QUIRC_CONTRAST_STRETCH
        bool "Enable contrast stretch before thresholding"
        default y
        help
            Stretches the grayscale histogram with percentile clipping
            before Otsu thresholding. Improves detection in low-contrast
            or dim lighting at a small per-frame cost (one LUT remap pass).

    config K_QUIRC_CONTRAST_CLIP_PCT
        int "Contrast stretch clip percentage (each tail)"
        default 5
        range 1 20
        depends on K_QUIRC_CONTRAST_STRETCH
        help
            Percentage of pixels to clip from each tail of the histogram
            before stretching. 5 = clip darkest 5% and brightest 5%.

    config K_QUIRC_DEBUG
        bool "Enable QR decoder debug visualization"
        default n

endmenu
```
